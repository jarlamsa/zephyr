## CMakeLists.txt
```
# SPDX-License-Identifier: Apache-2.0

cmake_minimum_required(VERSION 3.20.0)
find_package(Zephyr REQUIRED HINTS $ENV{ZEPHYR_BASE})
project(coap_async_client)

FILE(GLOB app_sources src/*.c)
target_sources(app PRIVATE ${app_sources})
target_include_directories(app PRIVATE ${ZEPHYR_BASE}/subsys/net/ip)
```

## prj.conf
```kconfig
# Generic networking options
CONFIG_NETWORKING=y
CONFIG_NEWLIB_LIBC=y
CONFIG_NET_IPV4=y
CONFIG_NET_IPV6=y
CONFIG_NET_UDP=y

CONFIG_NET_SOCKETS=y
CONFIG_NET_SOCKETS_POSIX_NAMES=y
CONFIG_NET_SOCKETS_POLL_MAX=4

CONFIG_COAP=y
CONFIG_COAP_CLIENT=y

# Kernel options
CONFIG_ENTROPY_GENERATOR=y
CONFIG_TEST_RANDOM_GENERATOR=y

# Logging
CONFIG_PRINTK=y
CONFIG_NET_LOG=y

# Network Shell
CONFIG_NET_SHELL=y

CONFIG_NET_CONFIG_SETTINGS=y
CONFIG_NET_CONFIG_NEED_IPV4=y
CONFIG_NET_CONFIG_MY_IPV4_ADDR="192.0.2.1"
CONFIG_NET_CONFIG_PEER_IPV4_ADDR="192.0.2.2"
CONFIG_NET_CONFIG_MY_IPV4_GW="192.0.2.2"

CONFIG_DNS_RESOLVER=y
CONFIG_DNS_SERVER_IP_ADDRESSES=y
CONFIG_DNS_SERVER1="192.0.2.2"

CONFIG_HEAP_MEM_POOL_SIZE=2048
```

## boards/native_posix.conf
```kconfig
# General network requirements
CONFIG_NETWORKING=y
CONFIG_NET_IPV4=y
CONFIG_NET_TCP=y
CONFIG_NET_UDP=y
CONFIG_NET_SOCKETS=y

# Native posix requirements
CONFIG_ENTROPY_GENERATOR=y
CONFIG_TEST_RANDOM_GENERATOR=y

CONFIG_NET_L2_ETHERNET=y
CONFIG_ETH_NATIVE_POSIX=y
CONFIG_ETH_NATIVE_POSIX_RANDOM_MAC=y

# IPv4 config
CONFIG_NET_CONFIG_SETTINGS=y
CONFIG_NET_CONFIG_NEED_IPV4=y
CONFIG_NET_CONFIG_MY_IPV4_ADDR="192.0.2.1"
CONFIG_NET_CONFIG_MY_IPV4_GW="192.0.2.2"
CONFIG_DNS_RESOLVER=y
CONFIG_DNS_RESOLVER_MAX_SERVERS=1
CONFIG_DNS_SERVER_IP_ADDRESSES=y
CONFIG_DNS_SERVER1="192.0.2.2"
```

## src/coap-client.c
```c
/*
 * Copyright (c) 2018 Intel Corporation
 *
 * SPDX-License-Identifier: Apache-2.0
 */

#include <zephyr/logging/log.h>
LOG_MODULE_REGISTER(net_coap_client_sample, LOG_LEVEL_DBG);

#include <errno.h>
#include <string.h>
#include <zephyr/sys/printk.h>
#include <zephyr/sys/byteorder.h>
#include <zephyr/kernel.h>

#include <zephyr/net/socket.h>
#include <zephyr/net/net_mgmt.h>
#include <zephyr/net/net_ip.h>
#include <zephyr/net/udp.h>
#include <zephyr/net/coap.h>
#include <zephyr/net/coap_client.h>

#include "net_private.h"

#define COAP_HOST "coap.me"
#define PEER_PORT "5683"
//#define MAX_COAP_MSG_LEN 256

/* CoAP socket fd */
static int sock;
static int sock2;

/* CoAP Options */
static const char *test_path = "test";
static const char *test_subpath = "path/sub1";
static const char *large_path = "large";
static const char *broken_path = "broken";
static const char *query_path = "query?whatsup";
static const char *separate_path = "separate";
static const char *large_update = "large-update";
static struct addrinfo *address;

static const char *short_payload = "testing";
static const char *test_payload = "Lorem ipsum dolor sit amet, consectetur adipiscing elit, sed do eiusmod tempor incididunt ut labore et dolore magna aliqua. Ut enim ad minim veniam, quis nostrud exercitation ullamco laboris nisi ut aliquip ex ea commodo consequat. Duis aute irure dolor in reprehenderit in voluptate velit esse cillum dolore eu fugiat nulla pariatur. Excepteur sint occaecat cupidatat non proident, sunt in culpa qui officia deserunt mollit anim id est laborum.";

static struct coap_client client;
static struct coap_client client2;

#define BLOCK_WISE_TRANSFER_SIZE_GET 2048

void coap_callback(int16_t code, size_t offset, const uint8_t *payload, size_t len, bool last_block,
		   void *user_data)
{	
        if (code == COAP_RESPONSE_CODE_CONTENT ||
	    code == COAP_RESPONSE_CODE_CHANGED ||
	    code == COAP_RESPONSE_CODE_DELETED ||
	    code == COAP_RESPONSE_CODE_CREATED) {
                if (len) {
			//LOG_DBG("Response received", payload);
                        printk("%s", payload);
                } else {
                        LOG_INF("Operation succcesfull\n");
                }
		if (last_block) {
			printk("\n");
			LOG_INF("Last packet received");
		}
        } else {
		LOG_ERR("Error in response %d", code);
	}
}

static int start_coap_client(void)
{

	static struct addrinfo hints;
	int st;
	int ret;

	hints.ai_family = AF_INET;
	hints.ai_socktype = SOCK_DGRAM;
	st = getaddrinfo(COAP_HOST, PEER_PORT, &hints, &address);
	LOG_INF("getaddrinfo status: %d\n", st);

	ret = coap_client_init(&client, NULL);

	LOG_INF("Return value %d", ret);

	ret = coap_client_init(&client2, NULL);

	LOG_INF("Return value %d", ret);

	if (st != 0) {
		LOG_ERR("Unable to resolve address, quitting\n");
		return -errno;
	}
	if (address == NULL) {
		LOG_ERR("Address not found\n");
		return -errno;
	}

	
	sock = socket(address->ai_family, address->ai_socktype, address->ai_protocol);
	if (sock < 0) {
		LOG_ERR("Failed to create UDP socket %d", errno);
		return -errno;
	}

	sock2 = socket(address->ai_family, address->ai_socktype, address->ai_protocol);
	if (sock < 0) {
		LOG_ERR("Failed to create UDP socket %d", errno);
		return -errno;
	}

	return 0;
}

int send_coap_request(uint8_t method, const char *path, const char *payload, int clientno)
{
	struct coap_client_option options[1];

	options[0].code = 17;
	options[0].len = 1;
	options[0].value[0] = 0;

	struct coap_client_request client_request = {
		.method = method,
		.confirmable = true,
		.path = path,
		.fmt = COAP_CONTENT_FORMAT_TEXT_PLAIN,
		.cb = coap_callback,
		.payload = NULL,
		.len = 0,
		.options = options,
		.num_options = 1
	};

	if (payload != NULL) {
		client_request.payload = payload;
		client_request.len = strlen(payload);
	}

	if (clientno == 1) {
		while (coap_client_req(&client, sock, address->ai_addr, &client_request, -1) == -EAGAIN) {
			LOG_INF("CoAP client1 busy");
			k_sleep(K_MSEC(500));
		}
	} else {
		while (coap_client_req(&client2, sock2, address->ai_addr, &client_request, -1) == -EAGAIN) {
			LOG_INF("CoAP client2 busy");
			k_sleep(K_MSEC(500));
		}
	}



	return 0;
}

static int test_coap_msgs(void)
{
	uint8_t test_type = 0U;
	int r;

	while (1) {
		switch (test_type) {
		case 0:
			/* Test CoAP GET method */
			LOG_INF("\nCoAP client GET\n");
			r = send_coap_request(COAP_METHOD_GET, test_path, NULL, 1);
			if (r < 0) {
				return r;
			}

			break;
		case 1:
			/* Test CoAP PUT method */
			LOG_INF("\nCoAP client PUT\n");
			r = send_coap_request(COAP_METHOD_PUT, test_path, NULL, 2);
			if (r < 0) {
				return r;
			}

			break;
		case 2:
			/* Test CoAP POST method*/
			LOG_INF("\nCoAP client POST\n");
			r = send_coap_request(COAP_METHOD_GET, test_path, NULL, 1);
			if (r < 0) {
				return r;
			}

			break;
		case 3:
			/* Test CoAP DELETE method*/
			LOG_INF("\nCoAP client DELETE\n");
			r = send_coap_request(COAP_METHOD_GET, test_path, NULL, 2);
			if (r < 0) {
				return r;
			}

			break;
		case 4:
			/* Test blockwise transfer GET */
			LOG_INF("\nBlockwise transfer GET\n");
			r = send_coap_request(COAP_METHOD_GET, large_path, NULL, 1);
			if (r < 0) {
				return r;
			}

			break;
		default:
			k_sleep(K_SECONDS(1));
			break;
		}
		test_type++;
	}

	return 0;
}

void main(void)
{
	int r;

	k_sleep(K_SECONDS(2));
	LOG_DBG("Start CoAP-client sample");
	k_sleep(K_SECONDS(1));
	r = start_coap_client();
	if (r < 0) {
		goto quit;
	}

	r = test_coap_msgs();
	if (r < 0) {
		goto quit;
	}

quit:
	(void)close(sock);
}
```
